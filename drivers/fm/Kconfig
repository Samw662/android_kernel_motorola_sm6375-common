## drivers/fm/Kconfig
```kconfig
config FM_CTRL
	tristate "FM Radio Controller"
	default m
	help
	  Enable FM radio controller support.

config RADIO_ELNA
	tristate "ELNA FM Radio"
	default n
	depends on FM_CTRL
	help
	  Choose Y here if you have this FM radio chip.
```

## drivers/misc/tps61280/Kconfig
```kconfig
config CIRRUS_CS40L2X
	tristate "Cirrus Logic CS40L2x haptic driver"
	help
	  Cirrus Logic CS40L2x haptic driver for bangkk platform.

config WEARYSTARS
	tristate "WearyStars kernel core"
	help
	  WearyStars kernel core module.
```

## drivers/watchdogtest/Kconfig
```kconfig
config WATCHDOGTEST
	tristate "Motorola watchdog test driver"
	help
	  Motorola watchdog test driver for bangkk platform.
```
